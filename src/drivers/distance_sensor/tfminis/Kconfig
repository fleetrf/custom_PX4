## src/drivers/distance_sensor/tfminis/Kconfig
```kconfig
menuconfig DRIVERS_DISTANCE_SENSOR_TFMINIS
	bool "tfminis"
	default y
	---help---
		Enable support for tfminis
```

## src/modules/collision_avoid_basic/Kconfig
```kconfig
menuconfig MODULES_COLLISION_AVOID_BASIC
	bool "collision_avoid_basic"
	default y
	---help---
		Enable support for collision_avoid_basic_app
```
